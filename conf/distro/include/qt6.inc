## conf/distro/include/qt6.inc
```bitbake
PACKAGECONFIG_append_pn-qtbase = " examples"
PACKAGECONFIG_append_pn-qtmqtt = " examples"
```

## conf/distro/include/suto.inc
```bitbake
MAINTAINER = "Ming Liu <liu.ming50@gmail.com>"

TARGET_VENDOR = "-suto"

SDK_VENDOR = "-suto"
SDK_VERSION = "suto.0"

DISTROOVERRIDES .= ":suto"

# Set default network configuration
PREFERRED_RPROVIDER_network-configuration = "networkmanager"

DISTRO_VERSION = "1.0.0"
DISTRO_FEATURES_remove = "ptest"
DISTRO_FEATURES_append = " pam systemd"

VIRTUAL-RUNTIME_init_manager = "systemd"
DISTRO_FEATURES_BACKFILL_CONSIDERED = "sysvinit"
VIRTUAL-RUNTIME_initscripts = ""

# SUTO Yocto does not use runtime package management, so version numbers going
# backwards are not a problem for us.
ERROR_QA_remove = "version-going-backwards"

require conf/distro/include/qt6.inc
```

## conf/distro/suto-wayland.conf
```bitbake
# SUTO Distro for Wayland.

require conf/distro/include/suto.inc

DISTRO = "suto-wayland"
DISTRO_NAME = "SUTO Wayland"

# Remove conflicting backends.
DISTRO_FEATURES_remove = "x11 opengl"

# These are Wayland specific
DISTRO_FEATURES_append = " wayland"

PREFERRED_VERSION_weston_forcevariable = "9.0.0"
```

## conf/distro/suto-x11.conf
```bitbake
# SUTO Distro for X11 without wayland.

require conf/distro/include/suto.inc

DISTRO = "suto-x11"
DISTRO_NAME = "SUTO X11"

# Remove conflicting backends.
DISTRO_FEATURES_remove = "wayland"

# These are X11 specific
DISTRO_FEATURES_append = " x11 opengl"
```

## conf/layer.conf
```bitbake
# We have a conf and classes directory, add to BBPATH
BBPATH .= ":${LAYERDIR}"

# We have recipes-* directories, add to BBFILES
BBFILES += "${LAYERDIR}/recipes-*/*/*.bb \
            ${LAYERDIR}/recipes-*/*/*.bbappend"

BBFILE_COLLECTIONS += "suto"
BBFILE_PATTERN_suto = "^${LAYERDIR}/"
BBFILE_PRIORITY_suto = "1000"

LAYERDEPENDS_suto = "core"
LAYERSERIES_COMPAT_suto = "dunfell"
```

## conf/machine/include/imx6ullevk.inc
```bitbake
IMX_DEFAULT_BSP = "mainline"

# Explicitly use fitimage
KERNEL_CLASSES_append = " kernel-suto-fitimage"
KERNEL_IMAGETYPE_imx6ullevk = "fitImage"

SOC_DEFAULT_IMAGE_FSTYPES = "wic"
WKS_FILE_DEPENDS_append = " u-boot-default-script"

IMAGE_BOOT_FILES_append = " boot.scr"
IMAGE_BOOT_FILES_remove = "${KERNEL_IMAGETYPE} ${@make_dtb_boot_files(d)}"

INITRAMFS_IMAGE = "suto-image-initramfs"
INITRAMFS_FSTYPES = "cpio.gz"

PREFERRED_RPROVIDER_u-boot-default-script_imx6ullevk_= "u-boot-suto-boot"
PREFERRED_PROVIDER_u-boot-fw-utils = "libubootenv"
PREFERRED_RPROVIDER_u-boot-fw-utils = "libubootenv"
PREFERRED_RPROVIDER_u-boot-default-env = "u-boot-fslc-env"
```

## conf/machine/include/qemuarm.inc
```bitbake
UBOOT_MACHINE = "qemu_arm_defconfig"
UBOOT_ENTRYPOINT = "0x40080000"

KERNEL_CLASSES = "kernel-suto-fitimage"
KERNEL_IMAGETYPE_qemuarm = "fitImage"

IMAGE_FSTYPES_qemuarm = "wic"

INITRAMFS_IMAGE = "suto-image-initramfs"
INITRAMFS_FSTYPES = "cpio.gz"

IMAGE_BOOT_FILES_qemuarm = "boot.scr"
WKS_FILE_DEPENDS_append = " virtual/bootloader u-boot-default-script"
WKS_FILE = "qemu-vdimage.wks"

# We are using fitimage for qemuarm machine
MACHINE_ESSENTIAL_EXTRA_RDEPENDS_remove = "kernel-devicetree"

QB_MACHINE = "-machine virt"
QB_DRIVE_TYPE = "/dev/vda"
QB_DEFAULT_FSTYPE = "wic"
QB_ROOTFS_OPT = "-drive file=@ROOTFS@,if=sd,format=raw"
QB_MEM_qemuarm = "-m 1057"
QB_OPT_APPEND_qemuarm = "-show-cursor -device VGA,edid=on -device qemu-xhci -device usb-tablet -device usb-kbd -object rng-random,filename=/dev/urandom,id=rng0 -device virtio-rng-pci,rng=rng0 -no-acpi -bios ${DEPLOY_DIR_IMAGE}/u-boot.bin -d unimp"
#QB_OPT_APPEND_qemuarm = "-nographic -object rng-random,filename=/dev/urandom,id=rng0 -device virtio-rng-pci,rng=rng0 -no-acpi -bios ${DEPLOY_DIR_IMAGE}/u-boot.bin -d unimp"

PREFERRED_RPROVIDER_network-configuration_qemuarm = "networkd-static-conf"
PREFERRED_RPROVIDER_u-boot-default-script_qemuarm = "u-boot-suto-boot"
PREFERRED_PROVIDER_u-boot-fw-utils = "libubootenv"
PREFERRED_RPROVIDER_u-boot-fw-utils = "libubootenv"
PREFERRED_RPROVIDER_u-boot-default-env = "u-boot-env"

BBMASK += " \
    /meta-suto/recipes-bsp/u-boot/u-boot-fslc_%.bbappend \
    meta-suto/recipes-kernel/linux/linux-fslc-imx_5.4.bbappend \
"
```

## scripts/lib/wic/canned-wks/qemu-vdimage.wks
```
part /boot --source bootimg-partition --ondisk vda --fstype=vfat --label boot --active --align 4 --size 16
part / --source rootfs --ondisk vda --fstype=ext4 --mkfs-extraopts="-O ^64bit,^metadata_csum -i 4096 -b 4096" --label root --align 4
```
